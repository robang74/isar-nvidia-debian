## conf/layer.conf
```bitbake
#
# Copyright (c) Siemens AG, 2019
#
# Authors:
#  Le Jin <le.jin@siemens.com>
#  Roberto A. Foglietta <roberto.foglietta@gmail.com>
#
# SPDX-License-Identifier: MIT
#

NVIDIA_DRIVER_VERSION = "515.65.07"
NVIDIA_CUDA_VERSION = "11-7"

BBPATH .= ":${LAYERDIR}"
BBFILES += "${LAYERDIR}/recipes-*/*/*.bb \
        ${LAYERDIR}/recipes-*/*/*.bbappend"
 
BBFILE_COLLECTIONS += "debx86"
BBFILE_PATTERN_debx86 = "^${LAYERDIR}/recipes-"
BBFILE_PRIORITY_debx86 = "7"
 
LAYERSERIES_COMPAT_debx86 = "next"
LAYERDIR_debx86 = "${LAYERDIR}"

BASE_DISTRO = "debian"
BASE_DISTRO_CODENAME = "bullseye"
HOST_BASE_DISTRO = "${BASE_DISTRO}"
HOST_DISTRO = "${BASE_DISTRO}-${BASE_DISTRO_CODENAME}"

DEBOOTSTRAP = "debootstrap"
DISTRO_DEBOOTSTRAP_SCRIPT = "/usr/share/debootstrap/scripts/${BASE_DISTRO_CODENAME}"

ISAR_RELEASE_CMD = "git -C ${LAYERDIR_debx86} describe --long --tags --dirty --always || echo unknown"

# The value for `SOURCE_DATE_EPOCH` should be latest source change time in
# SOURCE_DATE_EPOCH = "$(cat epoch.last 2>&1)"
```

## conf/machine/debx86.conf
```bitbake
#
# Copyright (c) Siemens AG, 2019-2022
#
# Authors:
#  Le Jin <le.jin@siemens.com>
#  Su Baocheng <baocheng.su@siemens.com>
#  Roberto A. Foglietta <roberto.foglietta@gmail.com>
#
# SPDX-License-Identifier: MIT
#

KERNEL_NAME = "amd64"
DISTRO_ARCH ?= "amd64"

WKS_FILE ?= "debx86"
IMAGE_FSTYPES ?= "wic"

SWUPDATE_BOOTLOADER = "efibootguard"
IMAGER_INSTALL += "${GRUB_BOOTLOADER_INSTALL}"

DISTRO_APT_SOURCES:append = " conf/distro/docker-com.list"
THIRD_PARTY_APT_KEYS:append = " https://download.docker.com/linux/debian/gpg;sha256sum=1500c1f56fa9e26b9b8f42452a553675796ade0807cdce11975eb98170b3a570"

DISTRO_APT_SOURCES:append = " conf/distro/nvidia-docker.list"
THIRD_PARTY_APT_KEYS:append = " https://nvidia.github.io/libnvidia-container/gpgkey;sha256sum=c880576d6cf75a48e5027a871bac70fd0421ab07d2b55f30877b21f1c87959c9"

DISTRO_APT_SOURCES:append = " conf/distro/nvidia-cuda-devel.list"
THIRD_PARTY_APT_KEYS:append = " https://developer.download.nvidia.com/compute/cuda/repos/debian11/x86_64/cuda-debian11-keyring.gpg;sha256sum=25100d6f2eccaee7d6719a70e3c0c6145064aa9edc2c32148f693ac4c524a376"
```

## wic/debx86-110GiB-vmdk.wks
```
#
# Copyright (c) Siemens AG, 2019-2022
#
# Authors:
#  Le Jin <le.jin@siemens.com>
#  Jan Kiszka <jan.kiszka@siemens.com>
#  Roberto A. Foglietta <roberto.foglietta@gmail.com>
#
# SPDX-License-Identifier: MIT
#

part --source bootimg-efi-isar --sourceparams "loader=grub-efi" --label efi --part-type EF00 --align 1024

part / --source rootfs --fstype ext4 --label rootfs --align 1024 --use-uuid --extra-space 83G --overhead-factor 1.2

bootloader --ptable gpt --timeout 3 --append "net.ifnames=0 biosdevname=0 scsi_mod.use_blk_mq=1 md_mod.use_blk_mq=1 tsc=nowatchdog"
```
